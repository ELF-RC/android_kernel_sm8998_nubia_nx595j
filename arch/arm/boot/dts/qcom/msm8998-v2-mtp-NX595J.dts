/* Copyright (c) 2016-2017, The Linux Foundation. All rights reserved.
 *
 * This program is free software; you can redistribute it and/or modify
 * it under the terms of the GNU General Public License version 2 and
 * only version 2 as published by the Free Software Foundation.
 *
 * This program is distributed in the hope that it will be useful,
 * but WITHOUT ANY WARRANTY; without even the implied warranty of
 * MERCHANTABILITY or FITNESS FOR A PARTICULAR PURPOSE.  See the
 * GNU General Public License for more details.
 */


/dts-v1/;

#include "msm8998-v2.dtsi"
#include "msm8998-mdss-panels.dtsi"
#include "msm8998-mtp.dtsi"

/ {
	model = "Qualcomm Technologies, Inc. MSM 8998 v2 MTP";
	compatible = "qcom,msm8998-mtp", "qcom,msm8998", "qcom,mtp";
	qcom,board-id = <8 0>;
};

/* ramoops: same layout as msm8998-mtp-NX595J.dts / msm8998-v2.1-mtp-NX595J.dts */
/ {
	reserved-memory {
		ramoops_reserved: ramoops_region@9fb00000 {
			compatible = "removed-dma-pool";
			no-map;
			reg = <0 0x9fb00000 0 0x100000>;
		};
	};

	ramoops {
		compatible = "ramoops";
		memory-region = <&ramoops_reserved>;
		record-size = <0x4000>;
		console-size = <0x40000>;
		pmsg-size = <0x4000>;
		ftrace-size = <0x0>;
	};
};
#include "nubia/NX595J/head.dtsi"
